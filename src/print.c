#include "buffer.h"
#include "print.h"
#include "LC-meter.h"

#if USE_HD44780_LCD
#include "lcd44780.h"
#endif

#if USE_NOKIA5110_LCD
#include "lcd5110.h"
#endif

#if USE_SER
#include "ser.h"
#endif

#include "format.h"
#define print_print_number(a, b, c) format_number(lcd_putch, a, b, c)

#ifndef USE_HD44780_LCD
void
lcd_puts(const char* string) {
  uint8_t i;
  for(i = 0; string[i]; i++) lcd_putch(string[i]);
}
#endif // !defined(USE_HD44780_LCD)

void
lcd_put(const char* buf, unsigned n) {
  uint8_t i;
  while(n--) lcd_putch(*buf++);
}

#if USE_NOKIA5110_LCD
#include "lcd5110.h"

const charlogo_image[504] = {
    0x00, 0x40, 0xC0, 0xC0, 0x80, 0x80, 0x00, 0x00, 0x00, 0x00, 0x00, 0x00, 0x00, 0x00, 0x00, 0x00, 0x00, 0x00, 0x00,
    0x00, 0x00, 0x00, 0x00, 0x00, 0x00, 0x00, 0x00, 0x00, 0x00, 0x00, 0x00, 0x00, 0x00, 0x00, 0x00, 0x00, 0x00, 0x00,
    0x00, 0x00, 0x00, 0x00, 0x00, 0x00, 0x00, 0x00, 0x00, 0x00, 0x00, 0x00, 0x00, 0x00, 0x00, 0xE0, 0xF8, 0xF0, 0xE0,
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    0x00, 0x00, 0x00, 0x00, 0x00, 0x00, 0x00, 0x00, 0x00, 0x00};

const char digits_8x16[160] = {
    0xfc, 0xfe, 0xfe, 0x06, 0x06, 0xfe, 0xfe, 0xfc, 0x7f, 0xff, 0xff, 0xc0, 0xc0, 0xff, 0xff, 0x7f, // 0
    0x00, 0x18, 0x1c, 0xfe, 0xfe, 0xfe, 0x00, 0x00, 0x00, 0x00, 0xc0, 0xff, 0xff, 0xff, 0xc0, 0x00, // 1
    0x3c, 0x3e, 0x3e, 0x06, 0x86, 0xfe, 0xfe, 0x7c, 0xe0, 0xf0, 0xfc, 0xff, 0xcf, 0xc7, 0xc1, 0xc0, // 2
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    0xfc, 0xfe, 0xfe, 0x86, 0x86, 0xfe, 0xfe, 0xfc, 0x78, 0xf9, 0xf9, 0xc1, 0xc1, 0xff, 0xff, 0x7f  // 9
};

const char units[288] = // 8units * (18*2)
    {
        // H = 0
        0,
        0,
        0,
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        31,
        // mH = 1
        224,
        224,
        192,
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        31,
        // uH = 2
        0,
        0,
        0,
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        31,
        // nH = 3
        0,
        0,
        0,
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        31,
        // mF = 4
        224,
        224,
        192,
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        0,
        // uF = 5
        0,
        0,
        0,
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        0,
        // nF = 6
        0,
        0,
        0,
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        0,
        // pF = 7
        0,
        0,
        0,
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        0,
        0};
#elif defined(USE_HD44780_LCD)
#include "lcd44780.h"
#endif

// -------------------------------------------------------------------------
// -------------------------------------------------------------------------
void
print_digit(uint8_t line, uint8_t column, uint8_t digit) {
#if USE_NOKIA5110_LCD
  uint8_t i;
  if(line < 1 || line > 5)
    return;
  if(column > 74)
    return;
  if(digit > 9)
    return;

  lcd_gotoxy(column, line - 1);
  for(i = 0; i < 8; i++) lcd_send(digits_8x16[(digit << 4) + i], LCD_TDATA);
  lcd_gotoxy(column, line);
  for(i = 8; i < 16; i++) lcd_send(digits_8x16[(digit << 4) + i], LCD_TDATA);
#elif defined(USE_HD44780_LCD)
  lcd_gotoxy(column, /*line - 1*/ 0);
  lcd_putch('0' + digit);
#endif // defined(USE_NOKIA5110_LCD)
}

// -------------------------------------------------------------------------
void
print_unit(uint8_t unit) {
#if USE_NOKIA5110_LCD
  uint8_t i;
  lcd_gotoxy(60, 2);
  for(i = 0; i < 18; i++) lcd_send(units[unit * 36 + i], LCD_TDATA);
  lcd_gotoxy(60, 3);
  for(i = 18; i < 36; i++) lcd_send(units[unit * 36 + i], LCD_TDATA);
#elif defined(USE_HD44780_LCD)
  static const char* units[8] = {"H", "mH", "uH", "nH", "mF", "uF", "nF", "pF"};
  lcd_gotoxy(14, 0);
  buffer_puts(units[unit]);
  /*lcd_gotoxy(14, 1);
  lcd_puts(units[unit]);*/
  lcd_gotoxy(16 - BUFFER_LEN(), 0);

  buffer_flush();
  ser_puts("\r\n");
#endif // defined(USE_NOKIA5110_LCD)
}

void
print_reading(uint16_t measurement) {

// measurement divide by 100
#if USE_NOKIA5110_LCD
  // clear previous measurement
  lcd_gotoxy(0, 2);
  lcd_puts(" ");
  lcd_gotoxy(0, 3);
  lcd_puts(" ");
  // decimal point
  lcd_gotoxy(35, 3);
  lcd_send(0x70, LCD_TDATA);
  lcd_send(0x70, LCD_TDATA);
  lcd_send(0x70, LCD_TDATA);
  // hundreds digit
  if(measurement / 10000 > 0)
    print_digit(3, 5, measurement / 10000);
  // tens digit
  if(((measurement / 1000) % 10 > 0) || (measurement / 10000 > 0))
    print_digit(3, 15, (measurement / 1000) % 10);
  // ones digit
  print_digit(3, 25, (measurement / 100) % 10);
  // tenths digit
  print_digit(3, 40, (measurement / 10) % 10);
  // hundredths digit
  print_digit(3, 50, measurement % 10);
#elif defined(USE_HD44780_LCD)
  lcd_gotoxy(9, 0);
  lcd_puts("     ");
  lcd_gotoxy(9, 0);
  // putchar_ptr = &buffer_putch;
  format_number(&buffer_putch, measurement / 100, 10, 0);
  buffer_putch('.');
  format_number(&buffer_putch, measurement % 100, 10, 0);

#endif // defined(USE_NOKIA5110_LCD)
}

// -------------------------------------------------------------------------
void
indicator(uint8_t indicate) {
#if USE_NOKIA5110_LCD
  if(indicate) {
    lcd_gotoxy(70, 4);
    lcd_send(0x1C, LCD_TDATA);
    lcd_send(0x3E, LCD_TDATA);
    lcd_send(0x36, LCD_TDATA);
    lcd_send(0x3E, LCD_TDATA);
    lcd_send(0x1C, LCD_TDATA);
  } else {
    lcd_gotoxy(70, 4);
    lcd_puts(" ");
  }
#elif defined(USE_HD44780_LCD)
  lcd_gotoxy(0, 1);
  if(indicate) {
    lcd_puts("-*-");
  } else {
    lcd_puts("   ");
  }
#endif // defined(USE_NOKIA5110_LCD)
}
