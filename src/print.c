#include "../lib/buffer.h"
#include "print.h"

#if USE_HD44780_LCD
#include "../lib/lcd44780.h"
#endif

#if USE_NOKIA5110_LCD
#include "../lib/lcd5110.h"
#endif

#if USE_UART
#include "../lib/uart.h"
#endif
#if USE_SER
#include "../lib/ser.h"
#endif

#include "../lib/format.h"

/*
 * Code of the micro sign in the display's character ROM: 0xE4 on the common
 * A00 (Japanese) HD44780 ROM, 0xB5 on the A02 (European) one. Override with
 * -DLCD_MU=0xB5 or -DLCD_MU="'u'" for a plain letter.
 */
#ifndef LCD_MU
#define LCD_MU ((char)0xE4)
#endif
#define print_print_number(a, b, c) format_number(a, b, c)

void
lcd_put(const char* buf, unsigned n) {
#ifdef USE_HD44780_LCD
  uint8_t i;
  while(n--) lcd_putch(*buf++);
#endif
}

#if USE_NOKIA5110_LCD
#include "../lib/lcd5110.h"

const charlogo_image[504] = {
    0x00, 0x40, 0xC0, 0xC0, 0x80, 0x80, 0x00, 0x00, 0x00, 0x00, 0x00, 0x00, 0x00, 0x00, 0x00, 0x00, 0x00, 0x00, 0x00,
    0x00, 0x00, 0x00, 0x00, 0x00, 0x00, 0x00, 0x00, 0x00, 0x00, 0x00, 0x00, 0x00, 0x00, 0x00, 0x00, 0x00, 0x00, 0x00,
    0x00, 0x00, 0x00, 0x00, 0x00, 0x00, 0x00, 0x00, 0x00, 0x00, 0x00, 0x00, 0x00, 0x00, 0x00, 0xE0, 0xF8, 0xF0, 0xE0,
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    0x00, 0x00, 0x00, 0x00, 0x00, 0x00, 0x00, 0x00, 0x00, 0x00};

const char digits_8x16[160] = {
    0xfc, 0xfe, 0xfe, 0x06, 0x06, 0xfe, 0xfe, 0xfc, 0x7f, 0xff, 0xff, 0xc0, 0xc0, 0xff, 0xff, 0x7f, // 0
    0x00, 0x18, 0x1c, 0xfe, 0xfe, 0xfe, 0x00, 0x00, 0x00, 0x00, 0xc0, 0xff, 0xff, 0xff, 0xc0, 0x00, // 1
    0x3c, 0x3e, 0x3e, 0x06, 0x86, 0xfe, 0xfe, 0x7c, 0xe0, 0xf0, 0xfc, 0xff, 0xcf, 0xc7, 0xc1, 0xc0, // 2
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    0xfc, 0xfe, 0xfe, 0x86, 0x86, 0xfe, 0xfe, 0xfc, 0x78, 0xf9, 0xf9, 0xc1, 0xc1, 0xff, 0xff, 0x7f  // 9
};

const char units[288] = { // 8units * (18*2)
    // H = 0
    0,
    0,
    0,
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    31,
    // mH = 1
    224,
    224,
    192,
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    31,
    // uH = 2
    0,
    0,
    0,
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    31,
    // nH = 3
    0,
    0,
    0,
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    31,
    // mF = 4
    224,
    224,
    192,
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    0,
    // uF = 5
    0,
    0,
    0,
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    0,
    // nF = 6
    0,
    0,
    0,
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    0,
    // pF = 7
    0,
    0,
    0,
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    0,
    0};
#elif defined(USE_HD44780_LCD)
#include "../lib/lcd44780.h"
#endif

// -------------------------------------------------------------------------
// -------------------------------------------------------------------------
void
print_digit(uint8_t line, uint8_t column, uint8_t digit) {
#if USE_NOKIA5110_LCD
  uint8_t i;
  if(line < 1 || line > 5)
    return;
  if(column > 74)
    return;
  if(digit > 9)
    return;

  lcd_gotoxy(column, line - 1);
  for(i = 0; i < 8; i++) lcd_send(digits_8x16[(digit << 4) + i], LCD_TDATA);
  lcd_gotoxy(column, line);
  for(i = 8; i < 16; i++) lcd_send(digits_8x16[(digit << 4) + i], LCD_TDATA);
#elif defined(USE_HD44780_LCD)
  lcd_gotoxy(column, /*line - 1*/ 0);
  lcd_putch('0' + digit);
#endif // defined(USE_NOKIA5110_LCD)
}

#if defined(USE_HD44780_LCD) || USE_SER
/* unit names, index as in measure.c: 0..3 = H mH uH nH, 4..7 = mF uF nF pF */
static const char unit_names[8][2] = {{'H', ' '}, {'m', 'H'}, {'u', 'H'}, {'n', 'H'}, {'m', 'F'}, {'u', 'F'}, {'n', 'F'}, {'p', 'F'}};

/* "ppp.ff" right-aligned, e.g. 105 -> "  1.05" */
static void
reading_text(char text[6], uint16_t measurement) {
  uint16_t whole = measurement / 100;
  uint8_t frac = measurement % 100;

  text[5] = '0' + frac % 10;
  text[4] = '0' + frac / 10;
  text[3] = '.';
  text[2] = '0' + whole % 10;
  text[1] = whole >= 10 ? '0' + (whole / 10) % 10 : ' ';
  text[0] = whole >= 100 ? '0' + whole / 100 : ' ';
}
#endif

#if USE_SER
static const char* serial_label = "";
#endif

// -------------------------------------------------------------------------
void
print_unit(uint8_t unit) {
#if USE_NOKIA5110_LCD
  uint8_t i;
  lcd_gotoxy(60, 2);
  for(i = 0; i < 18; i++) lcd_send(units[unit * 36 + i], LCD_TDATA);
  lcd_gotoxy(60, 3);
  for(i = 18; i < 36; i++) lcd_send(units[unit * 36 + i], LCD_TDATA);
#elif defined(USE_HD44780_LCD)
  const char* u = unit_names[unit & 7];

  lcd_gotoxy(14, 0);
  lcd_putch(u[0] == 'u' ? LCD_MU : u[0]);
  lcd_putch(u[1]);
#endif // defined(USE_NOKIA5110_LCD)
#if USE_SER
  /* completes the line started by print_label() / print_reading() */
  ser_putch(' ');
  ser_putch(unit_names[unit & 7][0]);
  if(unit_names[unit & 7][1] != ' ')
    ser_putch(unit_names[unit & 7][1]);
  ser_puts("\r\n");
#endif
}

void
print_reading(uint16_t measurement) {
#if defined(USE_HD44780_LCD) || USE_SER
  char text[6];
  uint8_t i;
#endif

// measurement divide by 100
#if USE_NOKIA5110_LCD
  // clear previous measurement
  lcd_gotoxy(0, 2);
  lcd_puts(" ");
  lcd_gotoxy(0, 3);
  lcd_puts(" ");
  // decimal point
  lcd_gotoxy(35, 3);
  lcd_send(0x70, LCD_TDATA);
  lcd_send(0x70, LCD_TDATA);
  lcd_send(0x70, LCD_TDATA);
  // hundreds digit
  if(measurement / 10000 > 0)
    print_digit(3, 5, measurement / 10000);
  // tens digit
  if(((measurement / 1000) % 10 > 0) || (measurement / 10000 > 0))
    print_digit(3, 15, (measurement / 1000) % 10);
  // ones digit
  print_digit(3, 25, (measurement / 100) % 10);
  // tenths digit
  print_digit(3, 40, (measurement / 10) % 10);
  // hundredths digit
  print_digit(3, 50, measurement % 10);
#endif // defined(USE_NOKIA5110_LCD)
#if defined(USE_HD44780_LCD) || USE_SER
  reading_text(text, measurement);
#endif
#ifdef USE_HD44780_LCD
  lcd_gotoxy(8, 0);
  for(i = 0; i < 6; i++) lcd_putch(text[i]);
#endif
#if USE_SER
  ser_puts(serial_label);
  ser_putch(' ');
  for(i = 0; i < 6; i++)
    if(text[i] != ' ')
      ser_putch(text[i]);
#endif
}

// -------------------------------------------------------------------------
/* Measurement name in the left 8 columns of the top line */
void
print_label(const char* label) {
#if USE_NOKIA5110_LCD
  lcd_gotoxy(0, 0);
  lcd_puts(label);
#elif defined(USE_HD44780_LCD)
  const char* l = label;
  uint8_t i;
  lcd_gotoxy(0, 0);
  for(i = 0; i < 8; i++) lcd_putch(*l ? *l++ : ' ');
#endif
#if USE_SER
  /* sent together with the reading, so debug output can't split the line */
  serial_label = label;
#endif
}

// -------------------------------------------------------------------------
/* Measurement failed (counts out of range) */
void
print_error(void) {
#if USE_NOKIA5110_LCD
  lcd_gotoxy(0, 2);
  lcd_puts("----");
#elif defined(USE_HD44780_LCD)
  lcd_gotoxy(8, 0);
  lcd_puts("  ----  ");
#endif
#if USE_SER
  ser_puts(serial_label);
  ser_puts(" range error\r\n");
#endif
}

// -------------------------------------------------------------------------
void
print_indicator(uint8_t indicate) {
#if USE_NOKIA5110_LCD
  if(indicate) {
    lcd_gotoxy(70, 4);
    lcd_send(0x1C, LCD_TDATA);
    lcd_send(0x3E, LCD_TDATA);
    lcd_send(0x36, LCD_TDATA);
    lcd_send(0x3E, LCD_TDATA);
    lcd_send(0x1C, LCD_TDATA);
  } else {
    lcd_gotoxy(70, 4);
    lcd_puts(" ");
  }
#elif defined(USE_HD44780_LCD)
  lcd_gotoxy(0, 1);
  if(indicate) {
    lcd_puts("-*-");
  } else {
    lcd_puts("   ");
  }
#endif // defined(USE_NOKIA5110_LCD)
}

void
output_putch(char c) {
#if USE_HD44780_LCD || USE_NOKIA5110_LCD
  lcd_putch(c);
#endif
#if USE_SER
  ser_putch(c);
#endif
}

/*
 * Put a string to the LCD and serial (if supported)
 */
void
put_str(const char* s) {
  int i;

  for(i = 0; s[i]; i++) {
    output_putch(s[i]);
  }
}

void
print_buffer(void) {
#if USE_SER
  uint8_t i;
  for(i = 0; i < buffer.n; i++) {
    ser_putch(buffer.x[i]);
  }
  ser_puts("\r\n");
#endif
}
